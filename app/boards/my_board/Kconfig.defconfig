## app/boards/my_board/Kconfig.defconfig
```kconfig
if BOARD_MY_BOARD

config CMU_HFXO_FREQ
	default 50000000

config CMU_HFRCO_FREQ
	default 72000000

config CMU_LFXO_FREQ
	default 32768

config LOG_BACKEND_SWO_FREQ_HZ
	default 875000
	depends on LOG_BACKEND_SWO

endif # BOARD_MY_BOARD
```

## app/boards/my_board/board.yml
```yaml
board:
  name: my_board
  full_name: My Board
  vendor: dont care
  socs:
  - name: efm32gg11b820f2048gl192
```

## app/boards/our_board/board.yml
```yaml
board:
  name: our_board
  full_name: Our Board
  vendor: dont care
  socs:
  - name: efm32gg11b820f2048gl192
```
